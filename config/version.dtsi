#define VERSION_MACRO
macro_ver: macro_ver {
compatible = "zmk,behavior-macro";
label = "macro_ver";
#binding-cells = <0>;
bindings = <&kp N2>, <&kp N0>, <&kp N2>, <&kp N4>, <&kp N0>, <&kp N3>, <&kp N1>, <&kp N8>, <&kp MINUS>, <&kp H>, <&kp E>, <&kp A>, <&kp D>, <&kp MINUS>, <&kp RET>;
};
